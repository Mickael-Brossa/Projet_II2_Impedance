# file: Mini_Projet_Brossa_Z.ioc
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ADC1.Channel-1\#ChannelRegularConversion=ADC_CHANNEL_0
ADC1.NbrOfConversionFlag=1
ADC1.Rank-1\#ChannelRegularConversion=1
ADC1.SamplingTime-1\#ChannelRegularConversion=ADC_SAMPLETIME_3CYCLES
ADC1.master=1
ADC3.Channel-0\#ChannelRegularConversion=ADC_CHANNEL_6
ADC3.Channel-IN6=ADC_CHANNEL_6
ADC3.Channel-IN7=ADC_CHANNEL_7
DAC.DAC_Trigger=DAC_TRIGGER_T7_TRGO
Dma.DAC1.0.Direction=DMA_MEMORY_TO_PERIPH
Dma.DAC1.0.FIFOMode=DMA_FIFOMODE_DISABLE
Dma.DAC1.0.Instance=DMA1_Stream5
Dma.DAC1.0.MemDataAlignment=DMA_MDATAALIGN_HALFWORD
Dma.DAC1.0.MemInc=DMA_MINC_ENABLE
Dma.DAC1.0.Mode=DMA_CIRCULAR
Dma.DAC1.0.PeriphDataAlignment=DMA_PDATAALIGN_HALFWORD
Dma.DAC1.0.PeriphInc=DMA_PINC_DISABLE
Dma.DAC1.0.Priority=DMA_PRIORITY_LOW
Dma.Request0=DAC1
FMC.CASLatency1=FMC_SDRAM_CAS_LATENCY_3
FMC.ExitSelfRefreshDelay1=7
FMC.LoadToActiveDelay1=2
FMC.RCDDelay1=2
FMC.RPDelay1=2
FMC.RPDelay2=2
FMC.ReadBurst1=FMC_SDRAM_RBURST_ENABLE
FMC.ReadBurst2=FMC_SDRAM_RBURST_ENABLE
FMC.RowCycleDelay1=7
FMC.RowCycleDelay2=7
FMC.SDClockPeriod1=FMC_SDRAM_CLOCK_PERIOD_2
FMC.SDClockPeriod2=FMC_SDRAM_CLOCK_PERIOD_2
FMC.SelfRefreshTime1=4
FMC.WriteRecoveryTime1=3
FREERTOS.INCLUDE_vTaskDelayUntil=1
FREERTOS.Queues01=Send_aff_vcc1,2,uint16_t,0,Dynamic,NULL,NULL;Send_aff_vcc2,2,uint16_t,0,Dynamic,NULL,NULL;Queue_freq,2,uint16_t,0,Dynamic,NULL,NULL;Queue_res,2,uint16_t,0,Dynamic,NULL,NULL;Queue_cond_est,2,uint32_t,0,Dynamic,NULL,NULL;Queue_res_est,2,uint32_t,0,Dynamic,NULL,NULL
FREERTOS.Tasks01=defaultTask,0,128,StartDefaultTask,Default,NULL,Dynamic,NULL,NULL;affichage,0,1024,Show_Value,Default,NULL,Dynamic,NULL,NULL;Mesure_crete_1,0,128,Mesure_crete_crete_1,Default,NULL,Dynamic,NULL,NULL;Choix_res_cond,0,128,Choix_mesure,Default,NULL,Dynamic,NULL,NULL;modif_freq_res,0,128,Modif_freq_res,Default,NULL,Dynamic,NULL,NULL;ges_freq_res,0,128,Ges_freq_res,Default,NULL,Dynamic,NULL,NULL;calcul_val,0,128,Calcul_val,Default,NULL,Dynamic,NULL,NULL
FREERTOS.configUSE_NEWLIB_REENTRANT=1
I2C1.Timing=0x00C0EAFF
I2C3.Timing=0x00C0EAFF
LTDC.ActiveH=272
LTDC.ActiveW=480
LTDC.Alpha_L0=255
LTDC.BlendingFactor1_L0=LTDC_BLENDING_FACTOR1_PAxCA
LTDC.BlendingFactor2_L0=LTDC_BLENDING_FACTOR2_PAxCA
LTDC.FBStartAdress_L0=0xC0000000
LTDC.HBP=13
LTDC.HFP=32
LTDC.HSync=41
LTDC.ImageHeight_L0=272
LTDC.ImageWidth_L0=480
LTDC.Layers=0
LTDC.PixelFormat_L0=LTDC_PIXEL_FORMAT_RGB565
LTDC.VSync=10
LTDC.WindowX1_L0=480
LTDC.WindowY1_L0=272
Mcu.Family=STM32F7
Mcu.Name=STM32F746NGHx
Mcu.Package=TFBGA216
NVIC.DMA1_Stream5_IRQn=true\:5\:0\:true\:false\:true\:true\:false\:true\:true
NVIC.DMA2D_IRQn=true\:5\:0\:false\:false\:true\:true\:true\:true\:true
NVIC.LTDC_IRQn=true\:5\:0\:false\:false\:true\:true\:true\:true\:true
NVIC.PriorityGroup=NVIC_PRIORITYGROUP_4
NVIC.TIM6_DAC_IRQn=true\:15\:0\:false\:false\:true\:false\:false\:true\:true
NVIC.TIM7_IRQn=true\:5\:0\:true\:false\:true\:true\:true\:true\:true
NVIC.TimeBase=TIM6_DAC_IRQn
NVIC.TimeBaseIP=TIM6
PA0/WKUP.Signal=ADCx_IN0
PA1.GPIO_Label=RMII_REF_CLK [LAN8742A-CZ-TR_REFCLK0]
PA1.Signal=ETH_REF_CLK
PA11.GPIO_Label=OTG_FS_N
PA11.Signal=USB_OTG_FS_DM
PA12.GPIO_Label=OTG_FS_P
PA12.Signal=USB_OTG_FS_DP
PA13.GPIO_Label=SWDIO
PA13.Mode=Serial_Wire
PA13.Signal=SYS_JTMS-SWDIO
PA14.GPIO_Label=SWCLK
PA14.Mode=Serial_Wire
PA14.Signal=SYS_JTCK-SWCLK
PA15.GPIO_Label=BP2
PA15.Signal=GPIO_Input
PA2.GPIO_Label=RMII_MDIO [LAN8742A-CZ-TR_MDIO]
PA2.Signal=ETH_MDIO
PA3.GPIO_Label=ULPI_D0 [USB3320C-EZK_D0]
PA3.Mode=Host_HS
PA3.Signal=USB_OTG_HS_ULPI_D0
PA4.Signal=COMP_DAC1_group
PA5.GPIO_Label=ULPI_CLK [USB3320C-EZK_CLKOUT]
PA5.Mode=Host_HS
PA5.Signal=USB_OTG_HS_ULPI_CK
PA6.Signal=GPIO_Input
PA7.GPIO_Label=RMII_CRS_DV [LAN8742A-CZ-TR_CRS_DV]
PA7.Signal=ETH_CRS_DV
PA8.GPIO_Label=BP1
PA8.Signal=GPIO_Input
PA9.GPIO_Label=VCP_TX [STM32F103CBT6_PA3]
PA9.GPIO_Mode=GPIO_MODE_AF_PP
PA9.GPIO_PuPd=GPIO_NOPULL
PA9.GPIO_Speed=GPIO_SPEED_FREQ_LOW
PA9.Mode=Asynchronous
PA9.Signal=USART1_TX
PB0.GPIO_Label=ULPI_D1 [USB3320C-EZK_D1]
PB0.Mode=Host_HS
PB0.Signal=USB_OTG_HS_ULPI_D1
PB1.GPIO_Label=ULPI_D2 [USB3320C-EZK_D2]
PB1.Mode=Host_HS
PB1.Signal=USB_OTG_HS_ULPI_D2
PB11.GPIO_Label=ULPI_D4 [USB3320C-EZK_D4]
PB11.Mode=Host_HS
PB11.Signal=USB_OTG_HS_ULPI_D4
PB12.GPIO_Label=ULPI_D5 [USB3320C-EZK_D5]
PB12.Mode=Host_HS
PB12.Signal=USB_OTG_HS_ULPI_D5
PB13.GPIO_Label=ULPI_D6 [USB3320C-EZK_D6]
PB13.Mode=Host_HS
PB13.Signal=USB_OTG_HS_ULPI_D6
PB14.GPIO_Label=ARDUINO MISO/D12
PB14.GPIO_Mode=GPIO_MODE_AF_PP
PB14.GPIO_PuPd=GPIO_NOPULL
PB14.GPIO_Speed=GPIO_SPEED_FREQ_LOW
PB14.Mode=Full_Duplex_Master
PB14.Signal=SPI2_MISO
PB15.GPIO_Label=ARDUINO MOSI/PWM/D11
PB15.GPIO_Mode=GPIO_MODE_AF_PP
PB15.GPIO_PuPd=GPIO_NOPULL
PB15.GPIO_Speed=GPIO_SPEED_FREQ_LOW
PB15.Mode=Full_Duplex_Master
PB15.Signal=SPI2_MOSI
PB2.Signal=QUADSPI_CLK
PB5.GPIO_Label=ULPI_D7 [USB3320C-EZK_D7]
PB5.Mode=Host_HS
PB5.Signal=USB_OTG_HS_ULPI_D7
PB6.GPIO_Label=QSPI_NCS [N25Q128A13EF840E_S]
PB6.Signal=QUADSPI_BK1_NCS
PB7.GPIO_Label=VCP_RX [STM32F103CBT6_PA2]
PB7.GPIO_Mode=GPIO_MODE_AF_PP
PB7.GPIO_PuPd=GPIO_NOPULL
PB7.GPIO_Speed=GPIO_SPEED_FREQ_LOW
PB7.Mode=Asynchronous
PB7.Signal=USART1_RX
PB8.Mode=I2C
PB8.Signal=I2C1_SCL
PB9.Mode=I2C
PB9.Signal=I2C1_SDA
PC0.GPIO_Label=ULPI_STP [USB3320C-EZK_STP]
PC0.Mode=Host_HS
PC0.Signal=USB_OTG_HS_ULPI_STP
PC1.GPIO_Label=RMII_MDC [LAN8742A-CZ-TR_MDC]
PC1.Signal=ETH_MDC
PC10.GPIO_Label=SDMMC_D2
PC10.Signal=SDMMC1_D2
PC11.GPIO_Label=SDMMC_D3
PC11.Signal=SDMMC1_D3
PC12.GPIO_Label=SDMMC_CK
PC12.Signal=SDMMC1_CK
PC13.GPIO_Label=uSD_Detect
PC13.Signal=GPIO_Input
PC14/OSC32_IN.GPIO_Label=RCC_OSC32_IN
PC14/OSC32_IN.Mode=LSE-External-Oscillator
PC14/OSC32_IN.Signal=RCC_OSC32_IN
PC15/OSC32_OUT.GPIO_Label=RCC_OSC32_OUT
PC15/OSC32_OUT.Mode=LSE-External-Oscillator
PC15/OSC32_OUT.Signal=RCC_OSC32_OUT
PC2.GPIO_Label=ULPI_DIR [USB3320C-EZK_DIR]
PC2.Mode=Host_HS
PC2.Signal=USB_OTG_HS_ULPI_DIR
PC3.GPIO_Label=FMC_SDCKE0 [MT48LC4M32B2B5-6A_CKE]
PC3.Mode=SdramChipSelect1_1
PC3.Signal=FMC_SDCKE0
PC4.GPIO_Label=RMII_RXD0 [LAN8742A-CZ-TR_RXD0]
PC4.Signal=ETH_RXD0
PC5.GPIO_Label=RMII_RXD1 [LAN8742A-CZ-TR_RXD1]
PC5.Signal=ETH_RXD1
PC6.GPIO_Label=ARDUINO TX/D1
PC6.Mode=Asynchronous
PC6.Signal=USART6_TX
PC7.GPIO_Label=ARDUINO RX/D0
PC7.Mode=Asynchronous
PC7.Signal=USART6_RX
PC8.Signal=SDMMC1_D0
PC9.Signal=SDMMC1_D1
PD0.GPIO_Label=FMC_D2 [MT48LC4M32B2B5-6A_DQ2]
PD0.Signal=FMC_D2_DA2
PD1.GPIO_Label=FMC_D3 [MT48LC4M32B2B5-6A_DQ3]
PD1.Signal=FMC_D3_DA3
PD10.GPIO_Label=FMC_D15 [MT48LC4M32B2B5-6A_DQ15]
PD10.Signal=FMC_D15_DA15
PD11.GPIO_Label=QSPI_D0 [N25Q128A13EF840E_DQ0]
PD11.Signal=QUADSPI_BK1_IO0
PD12.GPIO_Label=QSPI_D1 [N25Q128A13EF840E_DQ1]
PD12.Signal=QUADSPI_BK1_IO1
PD13.GPIO_Label=QSPI_D3 [N25Q128A13EF840E_DQ3]
PD13.Signal=QUADSPI_BK1_IO3
PD14.GPIO_Label=FMC_D0 [MT48LC4M32B2B5-6A_DQ0]
PD14.Signal=FMC_D0_DA0
PD15.GPIO_Label=FMC_D1 [MT48LC4M32B2B5-6A_DQ1]
PD15.Signal=FMC_D1_DA1
PD2.GPIO_Label=SDMMC_CMD
PD2.Signal=SDMMC1_CMD
PD3.GPIO_Label=LED16
PD3.Signal=GPIO_Output
PD4.GPIO_Label=OTG_FS_OverCurrent [STMPS2141STR_Fault]
PD4.Signal=GPIO_Input
PD5.GPIO_Label=OTG_FS_PowerSwitchOn [STMPS2141STR_EN]
PD5.PinState=GPIO_PIN_SET
PD5.Signal=GPIO_Output
PD6.GPIO_Label=Audio_INT
PD6.GPIO_ModeDefaultEXTI=GPIO_MODE_EVT_RISING
PD6.Signal=GPXTI6
PD7.GPIO_Label=SPDIF_RX0 [74LVC1G04SE_4]
PD7.Signal=SPDIFRX_IN0
PD8.GPIO_Label=FMC_D13 [MT48LC4M32B2B5-6A_DQ13]
PD8.Signal=FMC_D13_DA13
PD9.GPIO_Label=FMC_D14 [MT48LC4M32B2B5-6A_DQ14]
PD9.Signal=FMC_D14_DA14
PE0.GPIO_Label=FMC_NBL0 [MT48LC4M32B2B5-6A_DQM0]
PE0.Signal=FMC_NBL0
PE1.GPIO_Label=FMC_NBL1 [MT48LC4M32B2B5-6A_DQM1]
PE1.Signal=FMC_NBL1
PE10.GPIO_Label=FMC_D7 [MT48LC4M32B2B5-6A_DQ7]
PE10.Signal=FMC_D7_DA7
PE11.GPIO_Label=FMC_D8 [MT48LC4M32B2B5-6A_DQ8]
PE11.Signal=FMC_D8_DA8
PE12.GPIO_Label=FMC_D9 [MT48LC4M32B2B5-6A_DQ9]
PE12.Signal=FMC_D9_DA9
PE13.GPIO_Label=FMC_D10 [MT48LC4M32B2B5-6A_DQ10]
PE13.Signal=FMC_D10_DA10
PE14.GPIO_Label=FMC_D11 [MT48LC4M32B2B5-6A_DQ11]
PE14.Signal=FMC_D11_DA11
PE15.GPIO_Label=FMC_D12 [MT48LC4M32B2B5-6A_DQ12]
PE15.Signal=FMC_D12_DA12
PE2.GPIO_Label=QSPI_D2 [N25Q128A13EF840E_DQ2]
PE2.Signal=QUADSPI_BK1_IO2
PE3.GPIO_Label=OTG_HS_OverCurrent [STMPS2151STR_FAULT]
PE3.Signal=GPIO_Input
PE4.GPIO_Label=LCD_B0 [RK043FN48H-CT672B_B0]
PE4.Mode=RGB888
PE4.Signal=LTDC_B0
PE5.GPIO_Label=LED14
PE5.Signal=GPIO_Output
PE6.GPIO_Label=LED15
PE6.Signal=GPIO_Output
PE7.GPIO_Label=FMC_D4 [MT48LC4M32B2B5-6A_DQ4]
PE7.Signal=FMC_D4_DA4
PE8.GPIO_Label=FMC_D5 [MT48LC4M32B2B5-6A_DQ5]
PE8.Signal=FMC_D5_DA5
PE9.GPIO_Label=FMC_D6 [MT48LC4M32B2B5-6A_DQ6]
PE9.Signal=FMC_D6_DA6
PF0.GPIO_Label=FMC_A0 [MT48LC4M32B2B5-6A_A0]
PF0.Signal=FMC_A0
PF1.GPIO_Label=FMC_A1 [MT48LC4M32B2B5-6A_A1]
PF1.Signal=FMC_A1
PF10.Mode=IN8
PF10.Signal=ADC3_IN8
PF11.GPIO_Label=FMC_SDNRAS [MT48LC4M32B2B5-6A_RAS]
PF11.Signal=FMC_SDNRAS
PF12.GPIO_Label=FMC_A6 [MT48LC4M32B2B5-6A_A6]
PF12.Signal=FMC_A6
PF13.GPIO_Label=FMC_A7 [MT48LC4M32B2B5-6A_A7]
PF13.Signal=FMC_A7
PF14.GPIO_Label=FMC_A8 [MT48LC4M32B2B5-6A_A8]
PF14.Signal=FMC_A8
PF15.GPIO_Label=FMC_A9 [MT48LC4M32B2B5-6A_A9]
PF15.Signal=FMC_A9
PF2.GPIO_Label=FMC_A2 [MT48LC4M32B2B5-6A_A2]
PF2.Signal=FMC_A2
PF3.GPIO_Label=FMC_A3 [MT48LC4M32B2B5-6A_A3]
PF3.Signal=FMC_A3
PF4.GPIO_Label=FMC_A4 [MT48LC4M32B2B5-6A_A4]
PF4.Signal=FMC_A4
PF5.GPIO_Label=FMC_A5 [MT48LC4M32B2B5-6A_A5]
PF5.Signal=FMC_A5
PF6.Mode=Asynchronous
PF6.Signal=UART7_RX
PF7.Mode=Asynchronous
PF7.Signal=UART7_TX
PF8.GPIO_Label=ARDUINO A3
PF8.GPIO_Mode=GPIO_MODE_ANALOG
PF8.GPIO_PuPd=GPIO_NOPULL
PF8.Mode=IN6
PF8.Signal=ADC3_IN6
PF9.GPIO_Label=ARDUINO A2
PF9.GPIO_Mode=GPIO_MODE_ANALOG
PF9.GPIO_PuPd=GPIO_NOPULL
PF9.Mode=IN7
PF9.Signal=ADC3_IN7
PG0.GPIO_Label=FMC_A10 [MT48LC4M32B2B5-6A_A10]
PG0.Signal=FMC_A10
PG1.GPIO_Label=FMC_A11 [MT48LC4M32B2B5-6A_A11]
PG1.Signal=FMC_A11
PG10.GPIO_Label=SAI2_SDB [WM8994ECS/R_ADCDAT1]
PG10.Signal=SAI2_SD_B
PG11.GPIO_Label=RMII_TX_EN [LAN8742A-CZ-TR_TXEN]
PG11.Signal=ETH_TX_EN
PG12.GPIO_Label=LCD_B4 [RK043FN48H-CT672B_B4]
PG12.Mode=RGB888
PG12.Signal=LTDC_B4
PG13.GPIO_Label=RMII_TXD0 [LAN8742A-CZ-TR_TXD0]
PG13.Signal=ETH_TXD0
PG14.GPIO_Label=RMII_TXD1 [LAN8742A-CZ-TR_TXD1]
PG14.Signal=ETH_TXD1
PG15.GPIO_Label=FMC_SDNCAS [MT48LC4M32B2B5-6A_CAS]
PG15.Signal=FMC_SDNCAS
PG2.GPIO_Label=RMII_RXER
PG2.Signal=GPIO_Input
PG3.GPIO_Label=EXT_RST
PG3.Signal=GPIO_Output
PG4.GPIO_Label=FMC_BA0 [MT48LC4M32B2B5-6A_BA0]
PG4.Signal=FMC_A14_BA0
PG5.GPIO_Label=FMC_BA1 [MT48LC4M32B2B5-6A_BA1]
PG5.Signal=FMC_A15_BA1
PG6.GPIO_Label=ARDUINO D2
PG6.Signal=GPIO_Output
PG7.GPIO_Label=ARDUINO D4
PG7.Signal=GPIO_Output
PG8.GPIO_Label=FMC_SDCLK [MT48LC4M32B2B5-6A_CLK]
PG8.Signal=FMC_SDCLK
PG9.Signal=GPIO_Input
PH0/OSC_IN.GPIO_Label=OSC_25M [NZ2520SB-25.00M_OUT]
PH0/OSC_IN.Mode=HSE-External-Oscillator
PH0/OSC_IN.Signal=RCC_OSC_IN
PH1/OSC_OUT.Mode=HSE-External-Oscillator
PH1/OSC_OUT.Signal=RCC_OSC_OUT
PH10.GPIO_Label=LED18
PH10.Signal=GPIO_Output
PH11.GPIO_Label=LED12
PH11.Signal=GPIO_Output
PH12.GPIO_Label=LED17
PH12.Signal=GPIO_Output
PH13.Signal=GPIO_Input
PH14.GPIO_Label=LED13
PH14.Signal=GPIO_Output
PH15.GPIO_Label=TP3
PH15.Signal=GPIO_Input
PH2.GPIO_Label=NC2
PH2.Signal=GPIO_Input
PH3.GPIO_Label=FMC_SDNE0 [MT48LC4M32B2B5-6A_CS]
PH3.Mode=SdramChipSelect1_1
PH3.Signal=FMC_SDNE0
PH4.GPIO_Label=ULPI_NXT [USB3320C-EZK_NXT]
PH4.Mode=Host_HS
PH4.Signal=USB_OTG_HS_ULPI_NXT
PH5.GPIO_Label=FMC_SDNME [MT48LC4M32B2B5-6A_WE]
PH5.Signal=FMC_SDNWE
PH6.GPIO_Label=LED2
PH6.Signal=GPIO_Output
PH7.GPIO_Label=LCD_SCL [RK043FN48H-CT672B_SCL]
PH7.GPIO_Pu=GPIO_PULLUP
PH7.Mode=I2C
PH7.Signal=I2C3_SCL
PH8.GPIO_Label=LCD_SDA [RK043FN48H-CT672B_SDA]
PH8.GPIO_Pu=GPIO_PULLUP
PH8.Mode=I2C
PH8.Signal=I2C3_SDA
PH9.GPIO_Label=LED11
PH9.Signal=GPIO_Output
PI0.Mode=NSS_Signal_Hard_Output
PI0.Signal=SPI2_NSS
PI1.Mode=Full_Duplex_Master
PI1.Signal=SPI2_SCK
PI10.GPIO_Label=LCD_HSYNC [RK043FN48H-CT672B_HSYNC]
PI10.Mode=RGB888
PI10.Signal=LTDC_HSYNC
PI12.GPIO_Label=LCD_DISP [RK043FN48H-CT672B_DISP] 
PI12.PinState=GPIO_PIN_SET
PI12.Signal=GPIO_Output
PI13.GPIO_Label=LCD_INT
PI13.GPIO_ModeDefaultEXTI=GPIO_MODE_EVT_RISING
PI13.Signal=GPXTI13
PI14.GPIO_Label=LCD_CLK [RK043FN48H-CT672B_CLK]
PI14.Mode=RGB888
PI14.Signal=LTDC_CLK
PI15.GPIO_Label=LCD_R0 [RK043FN48H-CT672B_R0]
PI15.Mode=RGB888
PI15.Signal=LTDC_R0
PI2.Signal=S_TIM8_CH4
PI4.GPIO_Label=SAI2_MCLKA [WM8994ECS/R_MCLK1]
PI4.Signal=SAI2_MCLK_A
PI5.GPIO_Label=SAI2_SCKA [WM8994ECS/R_BCLK1]
PI5.Signal=SAI2_SCK_A
PI6.GPIO_Label=SAI2_SDA [WM8994ECS/R_DACDAT1]
PI6.Signal=SAI2_SD_A
PI7.GPIO_Label=SAI2_FSA [WM8994ECS/R_LRCLK1]
PI7.Signal=SAI2_FS_A
PI8.GPIO_Label=NC1 [TP2]
PI8.Mode=Timestamp enabled - Input Enabled to TS
PI8.Signal=RTC_TS
PI9.GPIO_Label=LCD_VSYNC [RK043FN48H-CT672B_VSYNC]
PI9.Mode=RGB888
PI9.Signal=LTDC_VSYNC
PJ0.GPIO_Label=LCD_R1 [RK043FN48H-CT672B_R1]
PJ0.Mode=RGB888
PJ0.Signal=LTDC_R1
PJ1.GPIO_Label=LCD_R2 [RK043FN48H-CT672B_R2]
PJ1.Mode=RGB888
PJ1.Signal=LTDC_R2
PJ10.GPIO_Label=LCD_G3 [RK043FN48H-CT672B_G3]
PJ10.Mode=RGB888
PJ10.Signal=LTDC_G3
PJ11.GPIO_Label=LCD_G4 [RK043FN48H-CT672B_G4]
PJ11.Mode=RGB888
PJ11.Signal=LTDC_G4
PJ12.GPIO_Label=OTG_FS_VBUS
PJ12.Signal=GPIO_Input
PJ13.GPIO_Label=LCD_B1 [RK043FN48H-CT672B_B1]
PJ13.Mode=RGB888
PJ13.Signal=LTDC_B1
PJ14.GPIO_Label=LCD_B2 [RK043FN48H-CT672B_B2]
PJ14.Mode=RGB888
PJ14.Signal=LTDC_B2
PJ15.GPIO_Label=LCD_B3 [RK043FN48H-CT672B_B3]
PJ15.Mode=RGB888
PJ15.Signal=LTDC_B3
PJ2.GPIO_Label=LCD_R3 [RK043FN48H-CT672B_R3]
PJ2.Mode=RGB888
PJ2.Signal=LTDC_R3
PJ3.GPIO_Label=LCD_R4 [RK043FN48H-CT672B_R4]
PJ3.Mode=RGB888
PJ3.Signal=LTDC_R4
PJ4.GPIO_Label=LCD_R5 [RK043FN48H-CT672B_R5]
PJ4.Mode=RGB888
PJ4.Signal=LTDC_R5
PJ5.GPIO_Label=LCD_R6 [RK043FN48H-CT672B_R6]
PJ5.Mode=RGB888
PJ5.Signal=LTDC_R6
PJ6.GPIO_Label=LCD_R7 [RK043FN48H-CT672B_R7]
PJ6.Mode=RGB888
PJ6.Signal=LTDC_R7
PJ7.GPIO_Label=LCD_G0 [RK043FN48H-CT672B_G0]
PJ7.Mode=RGB888
PJ7.Signal=LTDC_G0
PJ8.GPIO_Label=LCD_G1 [RK043FN48H-CT672B_G1]
PJ8.Mode=RGB888
PJ8.Signal=LTDC_G1
PJ9.GPIO_Label=LCD_G2 [RK043FN48H-CT672B_G2]
PJ9.Mode=RGB888
PJ9.Signal=LTDC_G2
PK0.GPIO_Label=LCD_G5 [RK043FN48H-CT672B_G5]
PK0.Mode=RGB888
PK0.Signal=LTDC_G5
PK1.GPIO_Label=LCD_G6 [RK043FN48H-CT672B_G6]
PK1.Mode=RGB888
PK1.Signal=LTDC_G6
PK2.GPIO_Label=LCD_G7 [RK043FN48H-CT672B_G7]
PK2.Mode=RGB888
PK2.Signal=LTDC_G7
PK3.GPIO_Label=LCD_BL_CTRL [STLD40DPUR_EN]
PK3.GPIO_Speed=GPIO_SPEED_FREQ_LOW
PK3.PinState=GPIO_PIN_SET
PK3.Signal=GPIO_Output
PK4.GPIO_Label=LCD_B5 [RK043FN48H-CT672B_B5]
PK4.Mode=RGB888
PK4.Signal=LTDC_B5
PK5.GPIO_Label=LCD_B6 [RK043FN48H-CT672B_B6]
PK5.Mode=RGB888
PK5.Signal=LTDC_B6
PK6.GPIO_Label=LCD_B7 [RK043FN48H-CT672B_B7]
PK6.Mode=RGB888
PK6.Signal=LTDC_B7
PK7.GPIO_Label=LCD_DE [RK043FN48H-CT672B_DE]
PK7.Mode=RGB888
PK7.Signal=LTDC_DE
ProjectManager.HeapSize=0x200
ProjectManager.StackSize=0x400
ProjectManager.TargetToolchain=STM32CubeIDE
RCC.AHBFreq_Value=200000000
RCC.APB1CLKDivider=RCC_HCLK_DIV4
RCC.APB1Freq_Value=50000000
RCC.APB1TimFreq_Value=100000000
RCC.APB2CLKDivider=RCC_HCLK_DIV2
RCC.APB2Freq_Value=100000000
RCC.APB2TimFreq_Value=200000000
RCC.CortexFreq_Value=200000000
RCC.HCLKFreq_Value=200000000
RCC.HSE_VALUE=25000000
RCC.HSI_VALUE=16000000
RCC.PLL48CLockSelection=RCC_CLK48SOURCE_PLLSAIP
RCC.PLLI2SN=100
RCC.PLLM=25
RCC.PLLN=400
RCC.PLLQ=9
RCC.PLLSAIN=384
RCC.PLLSAIP=RCC_PLLSAIP_DIV8
RCC.PLLSAIR=5
RCC.PLLSAIRDiv=RCC_PLLSAIDIVR_8
RCC.PLLSourceVirtual=RCC_PLLSOURCE_HSE
RCC.SDMMCClockSelection=RCC_SDMMC1CLKSOURCE_CLK48
RCC.SYSCLKFreq_VALUE=200000000
RCC.SYSCLKSource=RCC_SYSCLKSOURCE_PLLCLK
RCC.USBFreq_Value=48000000
RCC.VCOOutputFreq_Value=400000000
RTC.Alarm-Alarm\ A=RTC_ALARM_A
RTC.Alarm_B-Alarm\ B=RTC_ALARM_B
SH.ADCx_IN0.0=ADC1_IN0,IN0
SH.COMP_DAC1_group.0=DAC_OUT1,DAC_OUT1
SH.FMC_A0.0=FMC_A0,12b-sda1
SH.FMC_A1.0=FMC_A1,12b-sda1
SH.FMC_A10.0=FMC_A10,12b-sda1
SH.FMC_A11.0=FMC_A11,12b-sda1
SH.FMC_A14_BA0.0=FMC_BA0,FourSdramBanks1
SH.FMC_A15_BA1.0=FMC_BA1,FourSdramBanks1
SH.FMC_A2.0=FMC_A2,12b-sda1
SH.FMC_A3.0=FMC_A3,12b-sda1
SH.FMC_A4.0=FMC_A4,12b-sda1
SH.FMC_A5.0=FMC_A5,12b-sda1
SH.FMC_A6.0=FMC_A6,12b-sda1
SH.FMC_A7.0=FMC_A7,12b-sda1
SH.FMC_A8.0=FMC_A8,12b-sda1
SH.FMC_A9.0=FMC_A9,12b-sda1
SH.FMC_D0_DA0.0=FMC_D0,sd-16b-d1
SH.FMC_D10_DA10.0=FMC_D10,sd-16b-d1
SH.FMC_D11_DA11.0=FMC_D11,sd-16b-d1
SH.FMC_D12_DA12.0=FMC_D12,sd-16b-d1
SH.FMC_D13_DA13.0=FMC_D13,sd-16b-d1
SH.FMC_D14_DA14.0=FMC_D14,sd-16b-d1
SH.FMC_D15_DA15.0=FMC_D15,sd-16b-d1
SH.FMC_D1_DA1.0=FMC_D1,sd-16b-d1
SH.FMC_D2_DA2.0=FMC_D2,sd-16b-d1
SH.FMC_D3_DA3.0=FMC_D3,sd-16b-d1
SH.FMC_D4_DA4.0=FMC_D4,sd-16b-d1
SH.FMC_D5_DA5.0=FMC_D5,sd-16b-d1
SH.FMC_D6_DA6.0=FMC_D6,sd-16b-d1
SH.FMC_D7_DA7.0=FMC_D7,sd-16b-d1
SH.FMC_D8_DA8.0=FMC_D8,sd-16b-d1
SH.FMC_D9_DA9.0=FMC_D9,sd-16b-d1
SH.FMC_NBL0.0=FMC_NBL0,Sd2ByteEnable1
SH.FMC_NBL1.0=FMC_NBL1,Sd2ByteEnable1
SH.FMC_SDCLK.0=FMC_SDCLK,12b-sda1
SH.FMC_SDNCAS.0=FMC_SDNCAS,12b-sda1
SH.FMC_SDNRAS.0=FMC_SDNRAS,12b-sda1
SH.FMC_SDNWE.0=FMC_SDNWE,12b-sda1
SH.S_TIM8_CH4.0=TIM8_CH4
SPI2.CalculateBaudRate=25.0 MBits/s
SPI2.Direction=SPI_DIRECTION_2LINES
SPI2.Mode=SPI_MODE_MASTER
SPI2.VirtualNSS=VM_NSSHARD
SPI2.VirtualType=VM_MASTER
TIM7.Period=5555
TIM7.TIM_MasterOutputTrigger=TIM_TRGO_UPDATE
USART1.VirtualMode-Asynchronous=VM_ASYNC
USART6.VirtualMode-Asynchronous=VM_ASYNC
VP_DMA2D_VS_DMA2D.Mode=DMA2D_Activate
VP_FREERTOS_VS_CMSIS_V1.Mode=CMSIS_V1
VP_RTC_VS_RTC_Activate.Mode=RTC_Enabled
VP_RTC_VS_RTC_Alarm_A_Intern.Mode=Alarm A
VP_RTC_VS_RTC_Alarm_B_Intern.Mode=Alarm B
VP_RTC_VS_RTC_Calendar.Mode=RTC_Calendar
VP_SYS_VS_tim6.Mode=TIM6
VP_TIM1_VS_ClockSourceINT.Mode=Internal
VP_TIM2_VS_ClockSourceINT.Mode=Internal
VP_TIM3_VS_ClockSourceINT.Mode=Internal
VP_TIM7_VS_ClockSourceINT.Mode=Enable_Timer
VP_TIM8_VS_ClockSourceINT.Mode=Internal
board=STM32F746G-DISCO

// file: Core/Src/main.c
/* USER CODE BEGIN Header */
/**
  ******************************************************************************
  * @file           : main.c
  * @brief          : Main program body
  ******************************************************************************
  * @attention
  *
  * Copyright (c) 2022 STMicroelectronics.
  * All rights reserved.
  *
  * This software is licensed under terms that can be found in the LICENSE file
  * in the root directory of this software component.
  * If no LICENSE file comes with this software, it is provided AS-IS.
  *
  ******************************************************************************
  */
/* USER CODE END Header */
#include "main.h"
#include "cmsis_os.h"
#include "adc.h"
#include "dac.h"
#include "dma.h"
#include "dma2d.h"
#include "i2c.h"
#include "ltdc.h"
#include "rtc.h"
#include "spi.h"
#include "tim.h"
#include "usart.h"
#include "gpio.h"
#include "fmc.h"

/* USER CODE BEGIN Includes */
#include "stm32746g_discovery_lcd.h"
#include "stm32746g_discovery_ts.h"
#include "stdio.h"
#include "math.h"
/* USER CODE END Includes */

/* USER CODE BEGIN PV */
//uint16_t sinus12bit_360[360];
//uint16_t sinus12bit_180[180];
//uint16_t sinus12bit_90[90];
//uint16_t sinus12bit_45[45];
/* USER CODE END PV */

void SystemClock_Config(void);
void MX_FREERTOS_Init(void);

int main(void)
{
  /* USER CODE BEGIN 1 */
//	char text[50]={};
//	static TS_StateTypeDef  TS_State;
//	uint32_t potl,potr,joystick_h, joystick_v;

  /* USER CODE END 1 */

  /* MCU Configuration--------------------------------------------------------*/

  /* Reset of all peripherals, Initializes the Flash interface and the Systick. */
  HAL_Init();

  /* Configure the system clock */
  SystemClock_Config();

  /* Initialize all configured peripherals */
  MX_GPIO_Init();
  MX_DMA_Init();
  MX_DMA2D_Init();
  MX_FMC_Init();
  MX_I2C1_Init();
  MX_I2C3_Init();
  MX_LTDC_Init();
  MX_RTC_Init();
  MX_SPI2_Init();
  MX_TIM1_Init();
  MX_TIM2_Init();
  MX_TIM3_Init();
  MX_TIM8_Init();
  MX_USART1_UART_Init();
  MX_USART6_UART_Init();
  MX_ADC1_Init();
  MX_DAC_Init();
  MX_ADC3_Init();
  MX_UART7_Init();
  MX_TIM7_Init();
  /* USER CODE BEGIN 2 */
  BSP_LCD_Init();
  BSP_LCD_LayerDefaultInit(0, LCD_FB_START_ADDRESS);
  BSP_LCD_LayerDefaultInit(1, LCD_FB_START_ADDRESS+ BSP_LCD_GetXSize()*BSP_LCD_GetYSize()*4);
  BSP_LCD_DisplayOn();
  BSP_LCD_SelectLayer(0);
  BSP_LCD_Clear(LCD_COLOR_WHITE);
  BSP_LCD_SetBackColor(LCD_COLOR_WHITE);
  //BSP_LCD_DrawBitmap(0,0,(uint8_t*)HorombeRGB565_bmp);
  BSP_LCD_SelectLayer(1);
  BSP_LCD_Clear(LCD_COLOR_WHITE);
  BSP_LCD_SetBackColor(LCD_COLOR_WHITE);
  BSP_LCD_SetFont(&Font12);
  BSP_LCD_SetTextColor(LCD_COLOR_BLACK);
  //BSP_LCD_SetBackColor(00);

  BSP_TS_Init(BSP_LCD_GetXSize(), BSP_LCD_GetYSize());

//  int i;
//  for(i=0; i<45;i++)	{
//	  sinus12bit_360[i] = 2048 + 1024*sin(i*3.14159/180);
//	  sinus12bit_180[i] = 2048 + 1024*sin(i*3.14159/90);
//	  sinus12bit_90[i] = 2048 + 1024*sin(i*3.14159/45);
//	  sinus12bit_45[i] = 2048 + 1024*sin(2*i*3.14159/45);
//  }
//  for(i=45; i<90;i++)	{
//	  sinus12bit_360[i] = 2048 + 1024*sin(i*3.14159/180);
//	  sinus12bit_180[i] = 2048 + 1024*sin(i*3.14159/90);
//	  sinus12bit_90[i] = 2048 + 1024*sin(i*3.14159/45);
//    }
//  for(i=90; i<180;i++)	{
//	  sinus12bit_360[i] = 2048 + 1024*sin(i*3.14159/180);
//	  sinus12bit_180[i] = 2048 + 1024*sin(i*3.14159/90);
//    }
//  for(i=180; i<360;i++)	{
//	  sinus12bit_360[i] = 2048 + 1024*sin(i*3.14159/180);
//    }

  //Démarrage du timer 7 avec interruptions

  //Démarrage du DAC associé au tableau sinus12bit via le DMA
//  if (HAL_DAC_Start_DMA(&hdac, DAC_CHANNEL_1, (uint32_t*) sinus12bit_45, 45,
//  DAC_ALIGN_12B_R) != HAL_OK) {
//	  Error_Handler();
//  }
  /* USER CODE END 2 */

  /* Call init function for freertos objects (in freertos.c) */
  MX_FREERTOS_Init();

  /* Start scheduler */
  osKernelStart();

  /* We should never get here as control is now taken by the scheduler */
  /* Infinite loop */
  /* USER CODE BEGIN WHILE */
  while (1)
  {
//	HAL_GPIO_WritePin(LED13_GPIO_Port,LED13_Pin,HAL_GPIO_ReadPin(BP1_GPIO_Port,BP1_Pin));
//	HAL_GPIO_WritePin(LED14_GPIO_Port,LED14_Pin,HAL_GPIO_ReadPin(BP2_GPIO_Port,BP2_Pin));
//	sprintf(text,"BP1 : %d",HAL_GPIO_ReadPin(BP1_GPIO_Port,BP1_Pin));
//	BSP_LCD_DisplayStringAtLine(5,(uint8_t*) text);
//
//	sConfig.Channel = ADC_CHANNEL_6;
//	HAL_ADC_ConfigChannel(&hadc3, &sConfig);
//	HAL_ADC_Start(&hadc3);
//	while(HAL_ADC_PollForConversion(&hadc3, 100)!=HAL_OK);
//	potr = HAL_ADC_GetValue(&hadc3);
//
//	sConfig.Channel = ADC_CHANNEL_7;
//	HAL_ADC_ConfigChannel(&hadc3, &sConfig);
//	HAL_ADC_Start(&hadc3);
//	while(HAL_ADC_PollForConversion(&hadc3, 100)!=HAL_OK);
//	potl = HAL_ADC_GetValue(&hadc3);
//
//	sConfig.Channel = ADC_CHANNEL_8;
//	HAL_ADC_ConfigChannel(&hadc3, &sConfig);
//	HAL_ADC_Start(&hadc3);
//	while(HAL_ADC_PollForConversion(&hadc3, 100)!=HAL_OK);
//	joystick_v = HAL_ADC_GetValue(&hadc3);
//
//	HAL_ADC_Start(&hadc1);
//	while(HAL_ADC_PollForConversion(&hadc1, 100)!=HAL_OK);
//	joystick_h = HAL_ADC_GetValue(&hadc1);
//
//	sprintf(text,"POTL : %4u POTR : %4u joy_v : %4u joy_h : %4u",(uint)potl,(uint)potr,(uint)joystick_v,(uint)joystick_h);
//	BSP_LCD_DisplayStringAtLine(9,(uint8_t*) text);
//
//	BSP_TS_GetState(&TS_State);
//	if(TS_State.touchDetected){
//	  BSP_LCD_FillCircle(TS_State.touchX[0],TS_State.touchY[0],4);
//	  }
    /* USER CODE END WHILE */

  }
}

void SystemClock_Config(void)
{
  RCC_OscInitTypeDef RCC_OscInitStruct = {0};
  RCC_ClkInitTypeDef RCC_ClkInitStruct = {0};

  /** Configure LSE Drive Capability
  */
  HAL_PWR_EnableBkUpAccess();

  /** Configure the main internal regulator output voltage
  */
  __HAL_RCC_PWR_CLK_ENABLE();
  __HAL_PWR_VOLTAGESCALING_CONFIG(PWR_REGULATOR_VOLTAGE_SCALE1);

  /** Initializes the RCC Oscillators according to the specified parameters
  * in the RCC_OscInitTypeDef structure.
  */
  RCC_OscInitStruct.OscillatorType = RCC_OSCILLATORTYPE_LSI|RCC_OSCILLATORTYPE_HSE;
  RCC_OscInitStruct.HSEState = RCC_HSE_ON;
  RCC_OscInitStruct.LSIState = RCC_LSI_ON;
  RCC_OscInitStruct.PLL.PLLState = RCC_PLL_ON;
  RCC_OscInitStruct.PLL.PLLSource = RCC_PLLSOURCE_HSE;
  RCC_OscInitStruct.PLL.PLLM = 25;
  RCC_OscInitStruct.PLL.PLLN = 400;
  RCC_OscInitStruct.PLL.PLLP = RCC_PLLP_DIV2;
  RCC_OscInitStruct.PLL.PLLQ = 9;
  if (HAL_RCC_OscConfig(&RCC_OscInitStruct) != HAL_OK)
  {
    Error_Handler();
  }

  /** Activate the Over-Drive mode
  */
  if (HAL_PWREx_EnableOverDrive() != HAL_OK)
  {
    Error_Handler();
  }

  /** Initializes the CPU, AHB and APB buses clocks
  */
  RCC_ClkInitStruct.ClockType = RCC_CLOCKTYPE_HCLK|RCC_CLOCKTYPE_SYSCLK
                              |RCC_CLOCKTYPE_PCLK1|RCC_CLOCKTYPE_PCLK2;
  RCC_ClkInitStruct.SYSCLKSource = RCC_SYSCLKSOURCE_PLLCLK;
  RCC_ClkInitStruct.AHBCLKDivider = RCC_SYSCLK_DIV1;
  RCC_ClkInitStruct.APB1CLKDivider = RCC_HCLK_DIV4;
  RCC_ClkInitStruct.APB2CLKDivider = RCC_HCLK_DIV2;

  if (HAL_RCC_ClockConfig(&RCC_ClkInitStruct, FLASH_LATENCY_6) != HAL_OK)
  {
    Error_Handler();
  }
}

void HAL_TIM_PeriodElapsedCallback(TIM_HandleTypeDef *htim)
{
  if (htim->Instance == TIM6) {
    HAL_IncTick();
  }
  /* USER CODE BEGIN Callback 1 */
  if (htim->Instance == TIM7) {
	  HAL_GPIO_TogglePin(LED16_GPIO_Port, LED16_Pin);
  }
  /* USER CODE END Callback 1 */
}

void Error_Handler(void)
{
  __disable_irq();
  while (1)
  {
  }
}

// file: Core/Src/freertos.c
/* USER CODE BEGIN Header */
/**
  ******************************************************************************
  * File Name          : freertos.c
  * Description        : Code for freertos applications
  ******************************************************************************
  * @attention
  *
  * Copyright (c) 2023 STMicroelectronics.
  * All rights reserved.
  *
  * This software is licensed under terms that can be found in the LICENSE file
  * in the root directory of this software component.
  * If no LICENSE file comes with this software, it is provided AS-IS.
  *
  ******************************************************************************
  */
/* USER CODE END Header */

#include "FreeRTOS.h"
#include "task.h"
#include "main.h"
#include "cmsis_os.h"

/* USER CODE BEGIN Includes */
#include "stdio.h"
#include "stdlib.h"
#include "adc.h"
#include "math.h"
#include "dac.h"
#include "tim.h"
#include "stm32746g_discovery_lcd.h"
#include "stm32746g_discovery_ts.h"
/* USER CODE END Includes */

/* USER CODE BEGIN PM */

// tension du signal en sortie du filtre passe haut
#define tension_cc 5 // tension de la composante continue en entrée du banc
#define tension_max 690 // tension crete du signal en entrée du banc
#define facteur_corection_res 812 // en 1e-3, correction du resultat du calcul de la resistance
#define facteur_corection_cond 1222 // en 1e-3, correction du resultat du calcul de la capacite
//resistance utilise : 3300 Ohm, 10k Ohm, 33 kOhm, 100 kOhm

/* USER CODE END PM */

/* USER CODE BEGIN Variables */
ADC_ChannelConfTypeDef sConfig = {0};
int stat_mesure = 0; // -1 : sous-régime, 0 : regime etablie, 1 : sur-régime
int type_mesure = 0; // = 0 pour resistance, = 1 pour condensateur
int out_boundarie = 0; // booléen permettant de savoir si le composant à mesurer est en dehors de la plage de capture
uint16_t sinus12bit_360[360]; // tableau pour sinusoïde à 360 echantillon (basse fréquence)
uint16_t sinus12bit_180[180]; // tableau pour sinusoïde à 180 echantillon
uint16_t sinus12bit_90[90]; // tableau pour sinusoïde à 90 echantillon
uint16_t sinus12bit_45[45]; // tableau pour sinusoïde à 45 echantillon  (haute fréquence)
uint32_t freq_reel = 50; // frequence initial de 50 Hz
uint32_t res_reel = 3300; // resistance de mesure initial de 3.3 kOhm
uint16_t tension_mes = 1; // tension mesurer de base non nul afin d'eviter de possible singularité

/* USER CODE END Variables */
osThreadId defaultTaskHandle;
osThreadId affichageHandle;
osThreadId Mesure_crete_1Handle;
osThreadId Choix_res_condHandle;
osThreadId modif_freq_resHandle;
osThreadId ges_freq_resHandle;
osThreadId calcul_valHandle;
osMessageQId Send_aff_vcc1Handle;
osMessageQId Send_aff_vcc2Handle;
osMessageQId Queue_freqHandle;
osMessageQId Queue_resHandle;
osMessageQId Queue_cond_estHandle;
osMessageQId Queue_res_estHandle;

void StartDefaultTask(void const * argument);
void Show_Value(void const * argument);
void Mesure_crete_crete_1(void const * argument);
void Choix_mesure(void const * argument);
void Modif_freq_res(void const * argument);
void Ges_freq_res(void const * argument);
void Calcul_val(void const * argument);

void MX_FREERTOS_Init(void); /* (MISRA C 2004 rule 8.1) */

/* GetIdleTaskMemory prototype (linked to static allocation support) */
void vApplicationGetIdleTaskMemory( StaticTask_t **ppxIdleTaskTCBBuffer, StackType_t **ppxIdleTaskStackBuffer, uint32_t *pulIdleTaskStackSize );

/* USER CODE BEGIN GET_IDLE_TASK_MEMORY */
static StaticTask_t xIdleTaskTCBBuffer;
static StackType_t xIdleStack[configMINIMAL_STACK_SIZE];

void vApplicationGetIdleTaskMemory( StaticTask_t **ppxIdleTaskTCBBuffer, StackType_t **ppxIdleTaskStackBuffer, uint32_t *pulIdleTaskStackSize )
{
  *ppxIdleTaskTCBBuffer = &xIdleTaskTCBBuffer;
  *ppxIdleTaskStackBuffer = &xIdleStack[0];
  *pulIdleTaskStackSize = configMINIMAL_STACK_SIZE;
  /* place for user code */
}
/* USER CODE END GET_IDLE_TASK_MEMORY */

void MX_FREERTOS_Init(void) {
  /* USER CODE BEGIN Init */
	  int i;
	  for(i=0; i<45;i++)	{
		  sinus12bit_360[i] = 2048 + 1024*sin(i*3.14159/180);
		  sinus12bit_180[i] = 2048 + 1024*sin(i*3.14159/90);
		  sinus12bit_90[i] = 2048 + 1024*sin(i*3.14159/45);
		  sinus12bit_45[i] = 2048 + 1024*sin(2*i*3.14159/45);
	  }
	  for(i=45; i<90;i++)	{
		  sinus12bit_360[i] = 2048 + 1024*sin(i*3.14159/180);
		  sinus12bit_180[i] = 2048 + 1024*sin(i*3.14159/90);
		  sinus12bit_90[i] = 2048 + 1024*sin(i*3.14159/45);
	    }
	  for(i=90; i<180;i++)	{
		  sinus12bit_360[i] = 2048 + 1024*sin(i*3.14159/180);
		  sinus12bit_180[i] = 2048 + 1024*sin(i*3.14159/90);
	    }
	  for(i=180; i<360;i++)	{
		  sinus12bit_360[i] = 2048 + 1024*sin(i*3.14159/180);
	    }

	  if (HAL_DAC_Start_DMA(&hdac, DAC_CHANNEL_1, (uint32_t*) sinus12bit_360, 360,
			  DAC_ALIGN_12B_R) != HAL_OK) {
		  Error_Handler();
	  }

	  if (HAL_TIM_Base_Start_IT(&htim7) != HAL_OK) {
		  Error_Handler();
	  }

	  // On construit l'ensemble des tableau et on démarre le DMA avec le signal de fréquence maximum, soit
	  // de 5 kHz

	  HAL_GPIO_WritePin(LED13_GPIO_Port, LED13_Pin, 0);
	  HAL_GPIO_WritePin(LED14_GPIO_Port, LED14_Pin, 0);

	  // Les LEDs 13 et 14 permettent de savoir quel résistance on sélectionne sur le multiplexeur

	  //	Led 13		|	0		|	1		|	0		|	1		| ( 0 = éteint, 1 = allumé )
	  //	Led 14		|	0		|	0		|	1		|	1		|
	  //	Resistance	|   3.3k	|	10k		|	33k		|	100k	| (k pour kOhm)

  /* USER CODE END Init */

  /* Create the queue(s) */
  /* definition and creation of Send_aff_vcc1 */
  osMessageQDef(Send_aff_vcc1, 2, uint16_t);
  Send_aff_vcc1Handle = osMessageCreate(osMessageQ(Send_aff_vcc1), NULL);

  /* definition and creation of Send_aff_vcc2 */
  osMessageQDef(Send_aff_vcc2, 2, uint16_t);
  Send_aff_vcc2Handle = osMessageCreate(osMessageQ(Send_aff_vcc2), NULL);

  /* definition and creation of Queue_freq */
  osMessageQDef(Queue_freq, 2, uint16_t);
  Queue_freqHandle = osMessageCreate(osMessageQ(Queue_freq), NULL);

  /* definition and creation of Queue_res */
  osMessageQDef(Queue_res, 2, uint16_t);
  Queue_resHandle = osMessageCreate(osMessageQ(Queue_res), NULL);

  /* definition and creation of Queue_cond_est */
  osMessageQDef(Queue_cond_est, 2, uint32_t);
  Queue_cond_estHandle = osMessageCreate(osMessageQ(Queue_cond_est), NULL);

  /* definition and creation of Queue_res_est */
  osMessageQDef(Queue_res_est, 2, uint32_t);
  Queue_res_estHandle = osMessageCreate(osMessageQ(Queue_res_est), NULL);

  /* Create the thread(s) */
  /* definition and creation of defaultTask */
  osThreadDef(defaultTask, StartDefaultTask, osPriorityNormal, 0, 128);
  defaultTaskHandle = osThreadCreate(osThread(defaultTask), NULL);

  /* definition and creation of affichage */
  osThreadDef(affichage, Show_Value, osPriorityNormal, 0, 1024);
  affichageHandle = osThreadCreate(osThread(affichage), NULL);

  /* definition and creation of Mesure_crete_1 */
  osThreadDef(Mesure_crete_1, Mesure_crete_crete_1, osPriorityNormal, 0, 128);
  Mesure_crete_1Handle = osThreadCreate(osThread(Mesure_crete_1), NULL);

  /* definition and creation of Choix_res_cond */
  osThreadDef(Choix_res_cond, Choix_mesure, osPriorityNormal, 0, 128);
  Choix_res_condHandle = osThreadCreate(osThread(Choix_res_cond), NULL);

  /* definition and creation of modif_freq_res */
  osThreadDef(modif_freq_res, Modif_freq_res, osPriorityNormal, 0, 128);
  modif_freq_resHandle = osThreadCreate(osThread(modif_freq_res), NULL);

  /* definition and creation of ges_freq_res */
  osThreadDef(ges_freq_res, Ges_freq_res, osPriorityNormal, 0, 128);
  ges_freq_resHandle = osThreadCreate(osThread(ges_freq_res), NULL);

  /* definition and creation of calcul_val */
  osThreadDef(calcul_val, Calcul_val, osPriorityNormal, 0, 128);
  calcul_valHandle = osThreadCreate(osThread(calcul_val), NULL);

}

void StartDefaultTask(void const * argument)
{
  /* USER CODE BEGIN StartDefaultTask */
  /* Infinite loop */
  for(;;)
  {
    osDelay(1000);
  }
  /* USER CODE END StartDefaultTask */
}

void Show_Value(void const * argument)
{
  /* USER CODE BEGIN Show_Value */
  // cette tâche à pour but d'afficher à l'écran la tension crete mesurer au borne du composant à mersurer
  char text[50]={};
  TickType_t xLastWakeTime = xTaskGetTickCount();
  const TickType_t xPeriodMs = 300;
  uint32_t res_est; // Variable contenant l'estimation de la resistance
  uint32_t cond_est; // Variable contenant l'estimation du condensateur
  int wait=0; // variable d'attente, voir plus loin

  /* Infinite loop */
  for(;;)
  {
	  // Affichage du type de mesure en premier
	  if (type_mesure) {
		  sprintf(text," Mesure Condensateur");
		  BSP_LCD_DisplayStringAtLine(2,(uint8_t*) text);
	  }
	  else {
		  sprintf(text," Mesure Resistance  ");
		  BSP_LCD_DisplayStringAtLine(2,(uint8_t*) text);
	  }

	  // Affichage de la valeur image de la tension au borne de l'impédance à mesurer
	  if(xQueueReceive(Send_aff_vcc1Handle,&tension_mes,0)) {
		  sprintf(text," Tension crete bras = %04u mV",tension_mes);
		  BSP_LCD_DisplayStringAtLine(4,(uint8_t*) text);
	  }

	  // affichage de l'impédance si le régime est établie
	  if (stat_mesure==0) {
		  if(xQueueReceive(Queue_res_estHandle,&res_est,50)) {
			  sprintf(text," Possible resistance estimee = %012lu Ohm",res_est);
			  BSP_LCD_DisplayStringAtLine(8,(uint8_t*) text);
		  }
		  if(xQueueReceive(Queue_cond_estHandle,&cond_est,50)) {
			  sprintf(text," Possible condensateur estimee = %012lu pF",cond_est);
			  BSP_LCD_DisplayStringAtLine(10,(uint8_t*) text);
		  }
		  // On supprime les lignes affichant les pseudo-mesures du type d'impédance que l'on ne mesure pas,
		  // et on supprime aussi le message d'attente
		  BSP_LCD_ClearStringLine(6);
		  if (type_mesure) {
			  BSP_LCD_ClearStringLine(8);
		  }
		  else {
			  BSP_LCD_ClearStringLine(10);
		  }

	  }
	  else {
		  if (out_boundarie==0) {
			  // defilement de point expliquant que le système modifie la fréquence ou la résistance afin de trouver
			  // le bon calibre à adopter pour mesurer l'impédance.
			  switch (wait) {
				  case 0 :
					  sprintf(text," Transition frequence-resistance     ");
					  BSP_LCD_DisplayStringAtLine(6,(uint8_t*) text);
					  wait++;
					  break;
				  case 1 :
					  sprintf(text," Transition frequence-resistance .   ");
					  BSP_LCD_DisplayStringAtLine(6,(uint8_t*) text);
					  wait++;
					  break;
				  case 2 :
					  sprintf(text," Transition frequence-resistance ..  ");
					  BSP_LCD_DisplayStringAtLine(6,(uint8_t*) text);
					  wait++;
					  break;
				  case 3 :
					  sprintf(text," Transition frequence-resistance ... ");
					  BSP_LCD_DisplayStringAtLine(6,(uint8_t*) text);
					  wait++;
					  break;
				  case 4 :
					  sprintf(text," Transition frequence-resistance ....");
					  BSP_LCD_DisplayStringAtLine(6,(uint8_t*) text);
					  wait = 0;
					  break;
				  default :
					  sprintf(text," Transition frequence-resistance ....");
					  BSP_LCD_DisplayStringAtLine(6,(uint8_t*) text);
					  wait = 0;
					  break;
			  }
		  }
		  else {
			  // La résistance ou le condensateur est trop faible ou trop élevé
			  sprintf(text," En dehors de la capacite de mesure  ");
			  BSP_LCD_DisplayStringAtLine(6,(uint8_t*) text);
		  }
		  BSP_LCD_ClearStringLine(8);
		  BSP_LCD_ClearStringLine(10);
	  }

	  vTaskDelayUntil(&xLastWakeTime, xPeriodMs);

  }
  /* USER CODE END Show_Value */
}

void Mesure_crete_crete_1(void const * argument)
{
  /* USER CODE BEGIN Mesure_crete_crete_1 */
  // Cette tâche à pour but de récuperer la tension sur l'ADC1 et de déterminer si le système est en sur-régime,
  // sous-régime ou régime établie.
  sConfig.Rank = ADC_REGULAR_RANK_1;
  sConfig.SamplingTime = ADC_SAMPLETIME_3CYCLES;
  sConfig.Channel = ADC_CHANNEL_8;
  HAL_ADC_ConfigChannel(&hadc3, &sConfig);
  // On démarre le ADC pour capturer la tension crete au borne de l'impédance

  TickType_t xLastWakeTime = xTaskGetTickCount();
  const TickType_t xPeriodMs = 100;
  uint16_t Mesure=0; // variable qui contiendra la capture de l'ADC1

  /* Infinite loop */
  for(;;)
  {
	  // Capture de la tension sur l'ADC1
	  HAL_ADC_Start(&hadc3);
	  HAL_ADC_PollForConversion(&hadc3, 100);
	  Mesure = (uint16_t)HAL_ADC_GetValue(&hadc3);

	  // Détermination du type de régime. Les termes 2/10 et 8/10 ont été établie a posteriori d'un ensemble de mesure: ils
	  // permettent de trouver un compromis entre le nombre de résistance et de fréquence à utiliser pour obtenir
	  // une mesure assez précise
	  if (Mesure < (tension_max-tension_cc)*2/10) { //
		  stat_mesure = -1; // sous-regime
	  }
	  else if (Mesure > (tension_max-tension_cc)*8/10) { //
		  stat_mesure = 1; // sur-regime
	  }
	  else {
		  stat_mesure = 0; // régime établie
	  }

	  // On envoie la variable mesure à la tache Show_value pour affichage sur le LCD
	  xQueueSend(Send_aff_vcc1Handle,&Mesure,10);

	  vTaskDelayUntil(&xLastWakeTime, xPeriodMs);
  }
  /* USER CODE END Mesure_crete_crete_1 */
}

void Choix_mesure(void const * argument)
{
  /* USER CODE BEGIN Choix_mesure */
  // Cette tache à pour but de permettre à l'utilisateur de mesurer soit une résistance, soit un condensateur.
	// La selection se fait en cliquant soit à gauche de l'écran, soit à droite.
  TickType_t xLastWakeTime = xTaskGetTickCount();
  const TickType_t xPeriodMs = 100;
  static TS_StateTypeDef  TS_State;
  /* Infinite loop */
  for(;;)
  {
	  BSP_TS_GetState(&TS_State);
	  if(TS_State.touchDetected){
		  if (TS_State.touchX[0]<200) {
			  type_mesure=1;
		  }
		  else {
			  type_mesure=0;
		  }

	  }
	  vTaskDelayUntil(&xLastWakeTime, xPeriodMs);
  }
  /* USER CODE END Choix_mesure */
}

void Modif_freq_res(void const * argument)
{
  /* USER CODE BEGIN Modif_freq_res */
	// Cette tâche à pour but de modifier le choix de la fréquence ou le choix de la résistance en fonction de ce que
	// choisie la tache Ges_freq_res. Cette tache doit être rapide mais pas trop afin d'éviter de faire bugger le DMA.
  TickType_t xLastWakeTime = xTaskGetTickCount();
  const TickType_t xPeriodMs = 400;
  uint16_t freq = 0; // indice de la fréquence, qui peut valoir 0,1,2,3,4 ou 5.
  uint16_t res = 0; // indice de la résistance, qui peut valoir 0,1,2 ou 3.
  HAL_GPIO_WritePin(LED13_GPIO_Port, LED13_Pin, 0); // Les LEDs 13 et 14 sont éteintes afin de dire que la résistance
  HAL_GPIO_WritePin(LED14_GPIO_Port, LED14_Pin, 0); // au début est la plus faible.

  uint16_t* p_tab=sinus12bit_360; // on récuperer le pointeur d'un des tableau afin de modifier la variable à mettre
  	  // dans le DMA sur une seul ligne.
  int N=360; // variable donnant le nombre d'échantillon dans le tableau: utile pour le DMA.

  /* Infinite loop */
  for(;;)
  {
	  if (xQueueReceive(Queue_freqHandle,&freq,0)) {
		  // L'avantage d'utiliser une file d'attente est de permettre d'empecher de relancer constament de DMA.
		  // l'obtention des counter periods du timer 7 et le choix des tableau permettant d'obtenir une fréquence
		  // bien précise à été obtenue grace à la formule :
		  // 	frequence = 150 Mhz / (Counter_Period*Nombre_echantillon_tableau)
		  // Il faut noter que Counter_Period > 444 et qu'il faut maximiser Nombre_echantillon_tableau afin d'obtenir
		  // un signal "bien" sinusoïdale.
		  switch (freq) {
			  case 0:
				htim7.Init.Period = 5555;
				p_tab = sinus12bit_360;
				N=360;
				freq_reel = 50; // frequence de 50 Hz
				break;
		  	  case 1:
				htim7.Init.Period = 1111;
				p_tab = sinus12bit_360;
				N=360;
				freq_reel = 250; // frequence de 250 Hz
				break;
		  	  case 2:
		  		htim7.Init.Period = 555;
		  		p_tab = sinus12bit_360;
				N=360;
				freq_reel = 500; // frequence de 500 Hz
				break;
		  	  case 3:
		  		htim7.Init.Period = 555;
		  		p_tab = sinus12bit_180;
				N=180;
				freq_reel = 1000; // frequence de 1 kHz
				break;
		  	  case 4:
		  		htim7.Init.Period = 444;
		  		p_tab = sinus12bit_90;
				N=90;
				freq_reel = 2500; // frequence de 2.5 kHz
				break;
		  	  case 5:
		  		htim7.Init.Period = 444;
		  		p_tab = sinus12bit_45;
				N=45;
				freq_reel = 5000; // frequence de 5 kHz
				break;
		  	  default:
		  		htim7.Init.Period = 5555;
		  		p_tab = sinus12bit_360;
				N=360;
				freq_reel = 50; // frequence de 50 Hz
		  }

		  if (HAL_TIM_Base_Init(&htim7) != HAL_OK) {
			  Error_Handler(); // Changement du Counter Period du Timer 7
		  }
		  if (HAL_DAC_Stop_DMA(&hdac, DAC_CHANNEL_1) != HAL_OK) {
		  	Error_Handler(); // Arret du DMA
		  		  }
		  if (HAL_DAC_Start_DMA(&hdac, DAC_CHANNEL_1, (uint32_t*) p_tab, N, DAC_ALIGN_12B_R) != HAL_OK) {
			  Error_Handler(); // Redémarrage du DMA avec la nouvelle fréquence
		  }
	  }
	  if (xQueueReceive(Queue_resHandle,&res,0)) {
		  // Une fois plus, la fil d'attente permet de ne pas modifier constamment le choix de la résistance de calibrage.
		  switch (res) {
		  	  case 0:
				  HAL_GPIO_WritePin(LED13_GPIO_Port, LED13_Pin, 0);
				  HAL_GPIO_WritePin(LED14_GPIO_Port, LED14_Pin, 0);
				  res_reel=3300; // resistance de calibrage à 3.3 kOhm
		  		  break;
		  	  case 1:
				  HAL_GPIO_WritePin(LED13_GPIO_Port, LED13_Pin, 1);
				  HAL_GPIO_WritePin(LED14_GPIO_Port, LED14_Pin, 0);
				  res_reel=10000; // resistance de calibrage à 10 kOhm
		  		  break;
		  	  case 2:
				  HAL_GPIO_WritePin(LED13_GPIO_Port, LED13_Pin, 0);
				  HAL_GPIO_WritePin(LED14_GPIO_Port, LED14_Pin, 1);
				  res_reel=33000; // resistance de calibrage à 33 kOhm
		  		  break;
		  	  case 3:
				  HAL_GPIO_WritePin(LED13_GPIO_Port, LED13_Pin, 1);
				  HAL_GPIO_WritePin(LED14_GPIO_Port, LED14_Pin, 1);
				  res_reel=100000; // resistance de calibrage à 100 kOhm
		  		  break;
		  	  default:
				  HAL_GPIO_WritePin(LED13_GPIO_Port, LED13_Pin, 0);
				  HAL_GPIO_WritePin(LED14_GPIO_Port, LED14_Pin, 0);
				  res_reel=3300; // resistance de calibrage à 3.3 kOhm
		  }
	  }
	  vTaskDelayUntil(&xLastWakeTime, xPeriodMs);
  }
  /* USER CODE END Modif_freq_res */
}

void Ges_freq_res(void const * argument)
{
  /* USER CODE BEGIN Ges_freq_res */
	// Cette tache permet de choisir la resistance dans le multiplexeur/demultiplexeur et la
	// frequence selon le type de régime du système. Il faut noter que la période de cette tâche
	// doit être suffisament lent afin de permettre un changement de de fréquence/résistance trop rapide.

	TickType_t xLastWakeTime = xTaskGetTickCount();
	const TickType_t xPeriodMs = 2000;

	uint16_t freq = 0; // indice de fréquence future
	uint16_t res = 0; // indice de résistance future
	uint16_t freq_current = 0; // indice de fréquence actuelle
	uint16_t res_current = 0; // indice de résistance actuelle

	/* Infinite loop */
	for(;;)
	{

	  if (type_mesure == 0) { //pour mesure R
		  freq = 5; // meilleur precision en haute fréquence car détecteur de crête moins sujet à
		  //	des atténuations sévères.
		  if (stat_mesure==1) {
			  HAL_GPIO_WritePin(LED11_GPIO_Port, LED11_Pin, 1);
			  HAL_GPIO_WritePin(LED12_GPIO_Port, LED12_Pin, 0);
			  // Les LEDs 11 et 12 permettent de prendre en compte de l'état du système:
			  //	LED 11	|	1			|	0			|	0				|
			  //	LED 12	|	0			|	1			|	0				|
			  //	Système	|	Sur-régime	| Sous-régime	| Régime-établie	|
			  //
			  if (res_current<3) {
			  	  res++; // On augmente la résistance de calibrage si on est en sur-régime, ce qui permet
			  	  //de diminiuer la tension au borne de la résistance à mesurer
			  }
		  }
		  else if (stat_mesure==-1) {
			  HAL_GPIO_WritePin(LED11_GPIO_Port, LED11_Pin, 0);
			  HAL_GPIO_WritePin(LED12_GPIO_Port, LED12_Pin, 1);
			  if (res_current>0) {
			  	  res--; // sinon on diminue la résistance de calibrage afin  d'augmenter la tension au borne de la
			  	  // résistance de mesure
			  }
		  }
		  else {
		  		  HAL_GPIO_WritePin(LED11_GPIO_Port, LED11_Pin, 0);
		  		  HAL_GPIO_WritePin(LED12_GPIO_Port, LED12_Pin, 0);
		  	  }
	  }

	  //

	  else if (type_mesure == 1) { //pour mesure C
		  if (stat_mesure==1) {
			  HAL_GPIO_WritePin(LED11_GPIO_Port, LED11_Pin, 1);
			  HAL_GPIO_WritePin(LED12_GPIO_Port, LED12_Pin, 0);
			  if (res_current<3) {
				  res++; // on augmente d'abord la résistance de calibrage à fréquence fixe, afin de
				  // diminuer la tension au borne du condensateur.
			  }
			  else {
				  if (freq_current<5) {
					  // Si jamais la mise en place de la plus forte résistance n'a pas permis de changer de régime,
					  // alors on augmente la fréquence afin de laisser moins de temps au condensateur de se charger,
					  // ce qui va donc diminuer sa tension crête à ses bornes. On remet la résistance à 0 afin de
					  // recommencer la mesure du type de régime
					  freq++;
					  res = 0;
				  }
			  }
		  }
		  else if (stat_mesure==-1) { // même chose, mais dans l'autre sens.
			  HAL_GPIO_WritePin(LED11_GPIO_Port, LED11_Pin, 0);
			  HAL_GPIO_WritePin(LED12_GPIO_Port, LED12_Pin, 1);
			  if (res_current>0) {
				  res--;
			  }
			  else {
				  if (freq_current>0) {
					  freq--;
					  res = 3;
				  }
			  }
		  }
		  else {
		  		  HAL_GPIO_WritePin(LED11_GPIO_Port, LED11_Pin, 0);
		  		  HAL_GPIO_WritePin(LED12_GPIO_Port, LED12_Pin, 0);
		  	  }
	  }
	  else {
		  HAL_GPIO_WritePin(LED11_GPIO_Port, LED11_Pin, 0);
		  HAL_GPIO_WritePin(LED12_GPIO_Port, LED12_Pin, 0);
	  }

	  //

	  if (freq_current!=freq) {
		  xQueueSend(Queue_freqHandle,&freq,10); // si la fréquence doit être modifier, alors on envoie la nouvelle fréquence
		  // à la tache Modif_freq_res afin qu'elle effectue le changement.
	  }
	  if (res_current!=res) {
		  xQueueSend(Queue_resHandle,&res,10); // idem pour la résistance.
	  }

	  //

	  freq_current=freq;
	  res_current=res; // mise à jour des état de l'indice de la résistance et de la fréquence

	  //

	  if (((res_current==0) &&(freq_current==0)&&(stat_mesure))||((res_current==3) &&(freq_current==5)&&(stat_mesure))) {
		  out_boundarie = 1;
		  // si on a atteint la fréquence maximale et la résistance de calibrage maximal,
		  // et que l'on est toujours en sur-régime, alors on est en dehors de la plage de calibration.
		  // Inversement, si on est à la fréquence et résistance minimal, et que le système est en sous-régime,
		  // alors on est également en dehors de la plage de calibration.
	  }
	  else {
		  out_boundarie = 0;
	  }

	  vTaskDelayUntil(&xLastWakeTime, xPeriodMs);
	}
  /* USER CODE END Ges_freq_res */
}

void Calcul_val(void const * argument)
{
  /* USER CODE BEGIN Calcul_val */
  TickType_t xLastWakeTime = xTaskGetTickCount();
  const TickType_t xPeriodMs = 1000;

  uint32_t res_est = 0; // variable contenant la valeur de resistance estimée, en Ohm
  uint32_t cond_est = 0; // varaible contenant la valuer de resistance estimée, en pF

  /* Infinite loop */
  for(;;)
  {
	  if (stat_mesure==0) {
		  if (type_mesure==0) {
			  res_est = (uint32_t)((((float)(facteur_corection_res))/1000*(float)res_reel)/(((float)(tension_max-tension_cc))/((float)(tension_mes+1))-1.0+0.01));
			  xQueueSend(Queue_res_estHandle,&res_est,10);
		  }
		  else if (type_mesure==1){
			  cond_est = (uint32_t)(facteur_corection_cond*1000000000.0/(2*3.1415*(float)res_reel*(float)freq_reel)*sqrt(
					  (((float)(tension_max-tension_cc)))/(((float)(tension_mes+1)))*(
							  ((float)(tension_max-tension_cc))/((float)(tension_mes+1)))-1)	);
			  xQueueSend(Queue_cond_estHandle,&cond_est,10);
		  }
		  // Se référer au schéma du montage pour comprendre d'ou viennent les formules.
		  // Les facteurs de correction proviennent d'une comparaison entre les mesures de différentes résistances
		  // et condensateurs réalisés avec une machine permettant de d'obtenir des valeurs très précise des composants,
		  // et celles obtenues avec le banc d'essai. (voir Correction_V2.ods)
	  }
	  vTaskDelayUntil(&xLastWakeTime, xPeriodMs);
  }
  /* USER CODE END Calcul_val */
}
